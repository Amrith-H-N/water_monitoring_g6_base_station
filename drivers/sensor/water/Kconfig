## drivers/sensor/water/Kconfig
```kconfig
config WATER
	bool "water sensor"
	default y
	depends on DT_HAS_ZEPHYR_WATER_ENABLED
	select GPIO
	select SERIAL
	select UART_INTERRUPT_DRIVEN
	help
		"need water help!"

choice
	prompt "WATER oversampling"
	default WATER_OVER_2X
	help
	  Select time oversampling for the WATER sensors.  Higher values
	  lead to more accurate readings, but higher power consumption.
config WATER_OVER_1X
	bool "x1"
config WATER_OVER_2X
	bool "x2"
config WATER_OVER_4X
	bool "x4"
config WATER_OVER_8X
	bool "x8"
config WATER_OVER_16X
	bool "x16"
endchoice

choice
	prompt "WATER resolution"
	default WATER_RES_1X
	help
	  Select resolution for the WATER sensor.  Higher values
	  lead to more accurate readings, but higher power consumption.
config WATER_RES_1X
	bool "x1"
config WATER_RES_2X
	bool "x2"
endchoice
```
